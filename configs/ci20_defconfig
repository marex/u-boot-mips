## configs/ci20_defconfig
```kconfig
CONFIG_MIPS=y
CONFIG_SPL_LDSCRIPT="arch/mips/mach-jz47xx/jz4780/u-boot-spl.lds"
CONFIG_SYS_TEXT_BASE=0x80010000
CONFIG_SPL_GPIO_SUPPORT=y
CONFIG_SPL_LIBGENERIC_SUPPORT=y
CONFIG_SYS_MALLOC_F_LEN=0x2000
CONFIG_SPL_MMC_SUPPORT=y
CONFIG_SPL=y
CONFIG_ARCH_JZ47XX=y
CONFIG_DEFAULT_DEVICE_TREE="ci20"
CONFIG_FIT=y
CONFIG_DISPLAY_CPUINFO=y
CONFIG_BOARD_EARLY_INIT_F=y
CONFIG_HUSH_PARSER=y
CONFIG_CMD_MMC=y
CONFIG_CMD_DHCP=y
CONFIG_CMD_EXT4=y
CONFIG_CMD_FAT=y
# CONFIG_SPL_DOS_PARTITION is not set
# CONFIG_SPL_ISO_PARTITION is not set
CONFIG_OF_EMBED=y
CONFIG_JZ4780_EFUSE=y
CONFIG_MMC=y
# CONFIG_MMC_HW_PARTITIONING is not set
CONFIG_SPL_MMC_TINY=y
CONFIG_JZ47XX_MMC=y
CONFIG_DM_SERIAL=y
CONFIG_SYS_NS16550=y
CONFIG_USE_TINY_PRINTF=y
CONFIG_SPL_TINY_MEMSET=y
CONFIG_LZO=y
```
